## Kconfig
```kconfig
#
# For a description of the syntax of this configuration file,
# see Documentation/kbuild/kconfig-language.txt.
#
mainmenu "MYAPP Configuration"

config SRCARCH
	string
	option env="SRCARCH"

source "custom/$SRCARCH/Kconfig"
```

## client/Kconfig
```kconfig
config ENABLE_CF
	bool "Enable CF options"
	default y
	help
	  Say Y if you want to enable CF functionality.
```

## custom/common/configs/vb_defconfig
```kconfig
CONFIG_DEBUG_INFO=y
CONFIG_DEBUG_INFO_REDUCED=y
CONFIG_DEBUG_INFO_SPLIT=y
CONFIG_DEBUG_INFO_DWARF4=y
CONFIG_FOO=y
CONFIG_BAR=y
CONFIG_UI_V_B=y
```

## custom/common/ui/Kconfig
```kconfig
choice
	prompt "ui version"
	default UI_V_A

config UI_V_A
	bool "ui version for va"
	 help
	  config a version
	  

config UI_V_B
	bool "ui version for vb"
	 help
	  config B version

endchoice
```

## web/Kconfig
```kconfig
config CGI_VPN
	bool "Enable vpn"
	default y
	help
	  Say Y if you want to enable vpn.

config CGI_DEBUG
	bool "Enable debug"
	default n
	help
	  Say Y if you want to enable informational log message output.
```
